## conf/machine/imx8mm-trux-q01.conf
```bitbake
#@TYPE: Machine
#@NAME: imx8mm-trux-q01
#@SOC: i.MX8MM
#@DESCRIPTION: Machine configuration for imx8mm-trux-q01
#
# http://www.trucrux.com

MACHINEOVERRIDES =. "mx8mm:"
require conf/machine/include/imx-base.inc
require conf/machine/include/tune-cortexa53.inc

require trucrux.inc
require trucrux_bcmdhd.inc

# Trucrux BSP default providers
PREFERRED_PROVIDER_virtual/kernel:imx8mm-trux-q01 ?= "linux-trucrux"
PREFERRED_PROVIDER_u-boot:imx8mm-trux-q01 ?= "u-boot-trucrux"
PREFERRED_PROVIDER_u-boot-fw-utils:imx8mm-trux-q01 ?= "u-boot-fw-utils"
PREFERRED_PROVIDER_virtual/bootloader:imx8mm-trux-q01 ?= "u-boot-trucrux"

KERNEL_DEVICETREE = " \
	freescale/imx8mm-trux-8MDVP.dtb \
"
MACHINE_EXTRA_RRECOMMENDS:remove = " imx-m4-demos"

UBOOT_CONFIG ??= "sd"
UBOOT_CONFIG[sd] = "imx8mm_trucrux_config,sdcard"
SPL_BINARY = "spl/u-boot-spl.bin"

ATF_PLATFORM = "imx8mm"
ATF_LOAD_ADDR = "0x920000" 

# Set DDR FIRMWARE
DDR_FIRMWARE_NAME = " \
	ddr4_imem_1d.bin \
	ddr4_dmem_1d.bin \
	ddr4_imem_2d.bin \
	ddr4_dmem_2d.bin \
	lpddr4_pmu_train_1d_imem.bin \
	lpddr4_pmu_train_1d_dmem.bin \
	lpddr4_pmu_train_2d_imem.bin \
	lpddr4_pmu_train_2d_dmem.bin \
"
# Set U-Boot DTB
UBOOT_DTB_NAME = "imx8mm-trux-DVP.dtb"

# Set imx-mkimage boot target
IMXBOOT_TARGETS = "flash_lpddr4_ddr4_evk"

IMX_BOOT_SOC_TARGET = "iMX8MM"

# Extra firmware package name, that is required to build boot container for fslc bsp
IMX_EXTRA_FIRMWARE = "firmware-imx-8m" 

SERIAL_CONSOLES = "115200;ttymxc0 115200;ttymxc3"

IMAGE_BOOTLOADER = "imx-boot"

ROOTFS_SIZE = "3700"
LOADADDR = ""
UBOOT_SUFFIX = "bin"
UBOOT_MAKE_TARGET = "all"
IMX_BOOT_SEEK = "33"
```

## conf/machine/trucrux.inc
```bitbake
require trucrux-mirrors.inc
INHERIT += "image-buildinfo"

MACHINE_FEATURES += " pci bluetooth wifi"

IMX_DEFAULT_BSP = "nxp"

USE_VT = "0"

KERNEL_IMAGETYPE:mx8-nxp-bsp = "Image.gz"

SOC_DEFAULT_WKS_FILE:mx8-nxp-bsp = "imx-imx-boot-bootpart1.wks.in"

DEFAULTTUNE:mx8mq-nxp-bsp  ?= "cortexa53-crypto"
DEFAULTTUNE:mx8mm-nxp-bsp  ?= "cortexa53-crypto"

# Trucrux BSP default providers
PREFERRED_PROVIDER_u-boot = "u-boot-trucrux"
PREFERRED_PROVIDER_u-boot-fw-utils = "u-boot-fw-utils"
PREFERRED_PROVIDER_virtual/bootloader = "u-boot-trucrux"
PREFERRED_PROVIDER_virtual/kernel = "linux-trucrux"

# Use i.MX Gstreamer Version
MACHINE_GSTREAMER_1_0_PLUGIN:mx8-nxp-bsp = "imx-gst1.0-plugin"
#PREFERRED_VERSION_gstreamer1.0:mx8-nxp-bsp = "1.20.3.imx"
#PREFERRED_VERSION_gstreamer1.0-plugins-base:mx8-nxp-bsp = "1.20.3.imx"
#PREFERRED_VERSION_gstreamer1.0-plugins-good:mx8-nxp-bsp = "1.20.3.imx"
#PREFERRED_VERSION_gstreamer1.0-plugins-bad:mx8-nxp-bsp = "1.20.3.imx"

# Add VPU and Cortex M4/M7 firmware
MACHINE_FIRMWARE:append:mx8-nxp-bsp = " \
        firmware-imx-vpu-imx8 \
        "

MACHINE_EXTRA_RDEPENDS += " \
        gptfdisk \
        hostapd \
        hdparm \
        imx-kobs \
        iw \
        kernel-modules \
        kmod \
        ${@bb.utils.contains('DISTRO', 'b2qt', '', \
           bb.utils.contains('DISTRO_FEATURES', 'wayland', 'networkmanager', \
                                                       '', d), d)} \
        packagegroup-tools-bluetooth \
        bluez-alsa \
        pm-utils \
        rng-tools \
        wpa-supplicant \
        wireless-regdb-static \
        u-boot-fw-utils \
	u-boot-splash \
"

# Packages added to all images (including core-image-minimal)
IMAGE_INSTALL:append:mx8-nxp-bsp = " \
	kernel-image \
	kernel-devicetree \
"

IMAGE_FSTYPES = "tar.gz wic.gz"

# Wayland based distros add systemd to DISTRO_FEATURES
# Remove sysvinit or systemd based on DISTRO_FEATURES to avoid conflicts
DISTRO_FEATURES_BACKFILL_CONSIDERED:append = "${@bb.utils.contains('DISTRO_FEATURES', 'systemd', ' sysvinit', '', d)}"
DISTRO_FEATURES_BACKFILL_CONSIDERED:append = "${@bb.utils.contains('DISTRO_FEATURES', 'sysvinit', ' systemd', '', d)}"

# Use bluez-alsa instead of pulseaudio
DISTRO_FEATURES_BACKFILL_CONSIDERED:append = " pulseaudio"
```

## conf/machine/trucrux_bcmdhd.inc
```bitbake
MACHINE_EXTRA_RDEPENDS += " \
	bcm43xx-utils \
	brcm-patchram-plus \
	bcmdhd \
"
```
